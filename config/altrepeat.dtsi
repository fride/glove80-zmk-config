/ {
  behaviors {
        ad_rep_magic: ad_rep_magic {
            compatible = "zmk,behavior-antecedent-morph";
            label = "AD_REP_MAGIC";
            #binding-cells = <0>;
            defaults = <&kp H>;
            bindings = <&kp F> // A
                     , <&kp R> // B
                     , <&kp C> // C
                     , <&kp T> // D
                     , <&kp O> // E                
                     , <&kp K> // F
                     , <&kp T> // G
                     , <&kp H> // H -> some key so nothing ;)                     
                     , <&kp U> // I -> IU
                     , <&kp A> // J -> JA
                     , <&kp T> // K -> KT // TODO?!
                     , <&kp R> // L -> LR
                     , <&kp R> // N -> LR                     
                     , <&kp E> // O -> OE
                     , <&kp T> // P -> PT
                     , <&kp L> // R -> LR
                     , <&ch>   // S -> SCH
                     , <&kp D> // T -> DT
                     , <&kp I> // U -> UI
                     , <&ou>   // Y -> OU
                     // controll stuff!
                     , <&kp LC(K)>
                     ;
            antecedents = <
                A B C D E F G H I J K L N O P R S T U Y
                LCTL(A)
            
            >;
            max-delay-ms = <500>;
        };
  };
};
